## usb-output/main/Kconfig.projbuild
```kconfig
menu "Macro profile / web UI"

    config MACRO_WEB_UI
        bool "Enable Wi-Fi and HTTP profile upload"
        default n
        select ESP_WIFI_ENABLED
        select HTTPD_WS_SUPPORT
        help
            Mounts SPIFFS on partition "storage", starts Wi-Fi, serves minimal web UI.
            After enabling this, open the submenu "Wi-Fi and profile settings" below to choose
            SoftAP vs Station and set credentials.
            Requires a custom partition table with a SPIFFS "storage" partition.

    menu "Wi-Fi and profile settings"
        depends on MACRO_WEB_UI

        choice MACRO_WIFI_ROLE
            prompt "Wi-Fi role"
            default MACRO_WIFI_ROLE_SOFTAP
            help
                SoftAP: phone/PC connects to the ESP (no router needed).
                Station: ESP joins your home router; open the logged URL from any device on the same LAN.

            config MACRO_WIFI_ROLE_SOFTAP
                bool "SoftAP (ESP is the access point)"

            config MACRO_WIFI_ROLE_STA
                bool "Station (ESP joins main router)"
        endchoice

        config MACRO_WIFI_STA_SSID
            string "Router SSID (Station mode only)"
            depends on MACRO_WIFI_ROLE_STA
            default "mywifi"
            help
                Must be the 2.4 GHz network name (ESP32 does not support 5 GHz-only SSIDs).

        config MACRO_WIFI_STA_PASSWORD
            string "Router password (Station mode only, empty = open network)"
            depends on MACRO_WIFI_ROLE_STA
            default ""
            help
                WPA2 or WPA2/WPA3 mixed PSK. Rebuild after changing. On auth failures the
                serial log prints the disconnect reason (e.g. wrong password, SSID not found).

        choice MACRO_WIFI_STA_SECURITY
            prompt "Station Wi-Fi security mode"
            depends on MACRO_WIFI_ROLE_STA
            default MACRO_WIFI_STA_SECURITY_AUTO
            help
                Auto: let the ESP negotiate with the router (recommended).
                Use WPA2 or WPA3 only if Auto fails and you know the router mode.

            config MACRO_WIFI_STA_SECURITY_AUTO
                bool "Auto (negotiate WPA2/WPA3)"

            config MACRO_WIFI_STA_SECURITY_WPA2
                bool "Force WPA2-PSK"

            config MACRO_WIFI_STA_SECURITY_WPA3
                bool "Force WPA3-SAE"
        endchoice

        config MACRO_WIFI_STA_HOSTNAME
            string "DHCP hostname on LAN (optional, Station only)"
            depends on MACRO_WIFI_ROLE_STA
            default "usb-hid"
            help
                Sets the DHCP client hostname (visible on many routers). This build does not enable mDNS .local.

        config MACRO_WIFI_AP_SSID
            string "SoftAP SSID (SoftAP mode only)"
            depends on MACRO_WIFI_ROLE_SOFTAP
            default "USB-Config"

        config MACRO_WIFI_AP_PASSWORD
            string "SoftAP password (WPA2 min 8 chars; SoftAP mode only)"
            depends on MACRO_WIFI_ROLE_SOFTAP
            default "macro1234"

        config MACRO_WIFI_AP_CHANNEL
            int "SoftAP channel (SoftAP mode only)"
            depends on MACRO_WIFI_ROLE_SOFTAP
            default 1
            range 1 13

        config MACRO_SPIFFS_MOUNT
            string "SPIFFS mount path"
            default "/spiffs"

        config MACRO_PROFILE_JSON
            string "Profile JSON filename under SPIFFS mount"
            default "profile.json"

        config MACRO_PROFILE_MAX_SIZE
            int "Max profile JSON size (bytes)"
            default 131072
            range 4096 1048576
            help
                Large multi-weapon Rust/CS profiles are often 70–90 KB. Increase if uploads fail with "profile too large".

    endmenu

endmenu
```
